#include "OneWireHub.h"     // Library to emulate a Maxim OneWire slave, see https://github.com/orgua/OneWireHub
#include "DS2423.h"         // DS2423, four 32-bits counter and 4096 bits EEPROM
#include "RemoteReceiver.h" // RX433N or compatible 433 MHz receiver, see https://github.com/chrisandreae/RemoteReceiver

constexpr uint8_t pin_onewire   { 8 };  // Arduino pin connected to OneWire databus
constexpr uint8_t pin_led       { 13 }; // LED that flashes when a signal of an open mailbox is detected
constexpr uint32_t mail_received_code { 882377 }; // Code generated by radiotransmitter that we should listen after
constexpr uint32_t mail_detect_cooldown { 10000 }; // Don't signal new mail unless this much time has expired (in miliseconds)

auto hub    = OneWireHub(pin_onewire);
auto ds2423 = DS2423( DS2423::family_code, 0xDE, 0xAD, 0xBE, 0xEF, 0x10, 0x10 );    // Make up a unique OneWire address not already used in your network.
uint32_t radio_data_received = 0;
uint32_t mail_detect_time = 0;
uint32_t current_time = millis();

void setup() {
  Serial.begin(115200);
  Serial.println("OneWire-Hub emulating DS2423 for mailbox status reading. Address: 1D.DEADBEEF1010, counter B");

  pinMode(pin_led, OUTPUT);

  // Flash LED to show that we are ready.
  for (uint8_t cnt = 0; cnt < 5; cnt++) {
    digitalWrite(pin_led, LOW);
    delay(1000);
    digitalWrite(pin_led, HIGH);
    delay(1000);
  }

  // Setup OneWire
  hub.attach(ds2423);

  // Setup radio receiver
  RemoteReceiver::start(0); // library use interrupt #0 (pin 2),see http://playground.arduino.cc/Code/Interrupts

  Serial.println("setup done");
}

void loop() {

  // following function must be called periodically!
  hub.poll();

  current_time = millis();
    
  if (current_time > mail_detect_time + mail_detect_cooldown) {
    digitalWrite(pin_led, HIGH); // Turn LED off.
  }

  // Have we recived new data from radio receiver?
  if (RemoteReceiver::dataReady()) {
    radio_data_received = RemoteReceiver::getData();

    // Check if received data matches the code we are looking for AND more time than the "mail_detect_cooldown" has expired.
    if (radio_data_received == mail_received_code && current_time > mail_detect_time + mail_detect_cooldown) {
      mail_detect_time = current_time;
      
      digitalWrite(pin_led, LOW); // Turn LED on.
      ds2423.incrementCounter(3);

      Serial.println("Mailbox open number of times: " + ds2423.getCounter(3));
    }
  }
}
